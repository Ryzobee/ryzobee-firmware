## firmware/rootmaker/components/ryz_ota/Kconfig
```kconfig
menu "Ryzobee HTTPS OTA"

config RYZ_OTA_URL
    string "Firmware image URL"
    default ""
    help
        Fixed HTTPS URL used by the OTA worker. Leave empty to compile the
        component in a disabled state until a deployment endpoint is chosen.
        Only lowercase https:// URLs are accepted; HTTP and redirects are
        rejected. The module does not copy the URL into its public state or
        application logs. Do not embed credentials or query secrets: the URL
        remains in the firmware image and ESP-IDF diagnostics may expose it.

config RYZ_OTA_HTTP_TIMEOUT_MS
    int "HTTPS operation timeout (milliseconds)"
    range 1000 120000
    default 15000
    help
        Maximum blocking interval for an individual HTTPS operation. A cancel
        request is cooperative and may take up to this interval to be observed.

config RYZ_OTA_TASK_STACK_SIZE
    int "OTA worker task stack size (bytes)"
    range 6144 32768
    default 8192

config RYZ_OTA_TASK_PRIORITY
    int "OTA worker task priority"
    range 1 24
    default 5

endmenu
```

## firmware/rootmaker/components/ryz_time/Kconfig
```kconfig
menu "Ryzobee time synchronization"

config RYZ_NTP_SERVER
    string "Primary NTP server"
    default "pool.ntp.org"
    help
        Hostname used by the asynchronous SNTP client after STA is online.

config RYZ_TIME_TIMEZONE
    string "POSIX timezone"
    default "UTC0"
    help
        POSIX TZ string used by localtime. The system clock remains Unix UTC.

endmenu
```

## firmware/rootmaker/main/Kconfig.projbuild
```kconfig
menu "Ryzobee firmware"

config RYZ_LUA_FREETYPE
    bool "Enable the optional Lua FreeType font backend"
    default n
    help
        Include FreeType, seven subset TTF files and dynamic Lua glyph caches.
        Disabled by default: Lua UI uses the same audited static glyph tables
        as the C system UI, including the factory Monitor's existing sizes.
        Native C pages always use static fonts regardless of this option.

config RYZ_BOOT_DIAGNOSTICS
    bool "Run system, display and touch diagnostics before the system menu"
    default n
    help
        Embed and execute the C-owned Lua system self-check and legacy display
        and touch bring-up screens before starting the Ryzobee system menu.
        These resources are not user filesystem autorun scripts. Keep this
        disabled for the product boot flow; enable only for board diagnostics.

endmenu
```
